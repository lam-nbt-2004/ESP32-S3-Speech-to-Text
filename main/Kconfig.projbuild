## main/Kconfig.projbuild
```kconfig
menu "Voice assistant"
config VA_NS_ENABLE
    bool "Enable WebRTC microphone noise suppression"
    default y
    help
        Process microphone audio through ESP-SR WebRTC NS before Opus upload.
        Disable for comparison with the raw microphone path.
choice VA_STAGE
    prompt "Bring-up stage"
    default VA_STAGE_SERVER
config VA_STAGE_HW_TEST
    bool "Stage 1: automatic mic/speaker hardware check"
config VA_STAGE_AFE_TEST
    bool "Stage 2: WakeNet/AFE with local playback"
config VA_STAGE_SERVER
    bool "Stage 3: WakeNet/AFE + Opus + voice server"
endchoice
config VA_WIFI_SSID
    string "Wi-Fi SSID"
    default ""
config VA_WIFI_PASSWORD
    string "Wi-Fi password"
    default ""
config VA_DEVICE_WS_URI
    string "Device WebSocket URI (/ws/device)"
    default "ws://192.168.1.10:8000/ws/device"
config VA_DEVICE_TOKEN
    string "Device token (optional)"
    default ""
config VA_WAKE_WORD_TEXT
    string "Wake phrase reported to server"
    default "Hi ESP"
    depends on VA_STAGE_SERVER
endmenu
```

## sdkconfig.defaults
```kconfig
CONFIG_IDF_TARGET="esp32s3"
CONFIG_ESPTOOLPY_FLASHSIZE_16MB=y
CONFIG_ESPTOOLPY_FLASHSIZE="16MB"
CONFIG_PARTITION_TABLE_CUSTOM=y
CONFIG_PARTITION_TABLE_CUSTOM_FILENAME="partitions.csv"
CONFIG_PARTITION_TABLE_OFFSET=0x8000
CONFIG_SPIRAM=y
CONFIG_SPIRAM_MODE_OCT=y
CONFIG_SPIRAM_TYPE_AUTO=y
CONFIG_SPIRAM_SPEED_80M=y
CONFIG_SPIRAM_USE_MALLOC=y
CONFIG_SPIRAM_BOOT_INIT=y
CONFIG_ESP_DEFAULT_CPU_FREQ_MHZ_240=y
CONFIG_MBEDTLS_CERTIFICATE_BUNDLE=y
CONFIG_MBEDTLS_CERTIFICATE_BUNDLE_DEFAULT_FULL=y
CONFIG_MBEDTLS_EXTERNAL_MEM_ALLOC=y
CONFIG_VA_STAGE_SERVER=y
CONFIG_SR_WN_WN9_HIESP=y
CONFIG_VA_NS_ENABLE=y
CONFIG_OPUS_PSEUDOSTACK_SIZE=240000
# CONFIG_OPUS_ENABLE_XTENSA_OPTIMIZATIONS is not set
```
